VERSION ""

NS_ :

BS_:
BU_: hello
BO_ 0 helloMsg: 8 hello
   SG_ 8_bit_unsigned_int : 7|8@0+ (1,0) [0|1] "" hello

BA_DEF_ BO_ "GenMsgBackgroundColor" STRING ;
BA_DEF_ BO_ "GenMsgForegroundColor" STRING ;
BA_DEF_ BO_ "filterlabeling" INT 0 0;
BA_DEF_DEF_ "GenMsgBackgroundColor" "#ffffff";
BA_DEF_DEF_ "GenMsgForegroundColor" "#000000";
BA_DEF_DEF_ "filterlabeling" 1;
BA_ "GenMsgBackgroundColor" BO_ 0 "#b6eeff";
BA_ "GenMsgForegroundColor" BO_ 0 "#5d6ea9";
