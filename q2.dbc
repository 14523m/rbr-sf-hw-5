VERSION ""

NS_ :

BS_:
BU_:
BO_ 1056 Request: 1 Vector__XXX
   SG_ RequestSig : 7|8@0+ (1,0) [0|256] "" Vector__XXX

BO_ 1680 AnalogReading: 2 Vector__XXX
   SG_ AnalogReadingSig : 7|16@0+ (1,0) [0|65535] "" Vector__XXX

BA_DEF_ BO_ "GenMsgBackgroundColor" STRING ;
BA_DEF_ BO_ "GenMsgForegroundColor" STRING ;
BA_DEF_ BO_ "filterlabeling" INT 0 0;
BA_DEF_DEF_ "GenMsgBackgroundColor" "#ffffff";
BA_DEF_DEF_ "GenMsgForegroundColor" "#000000";
BA_DEF_DEF_ "filterlabeling" 1;
BA_ "GenMsgForegroundColor" BO_ 1056 "#1c1e51";
BA_ "GenMsgBackgroundColor" BO_ 1056 "#e4e7ff";
BA_ "GenMsgBackgroundColor" BO_ 1680 "#ef92a6";
VAL_ 1056 RequestSig 105 "request_message._Other_values:_don't_care.";
